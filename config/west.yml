## config/west.yml
```yaml
manifest:
  remotes:
    - name: zmkfirmware
      url-base: https://github.com/zmkfirmware
  projects:
    - name: zmk
      remote: zmkfirmware
      # main on June 20, 2023
      revision: b259d5a22e423458b94bd1aba70fd62f327528c0
      import: app/west.yml
  self:
    path: config
```
